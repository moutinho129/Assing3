## build/Kconfig/Kconfig.shield.defconfig
```kconfig
osource "/home/moutinho/Desktop/assing3/boards/shields/*/Kconfig.defconfig"
osource "/home/moutinho/ncs/v2.6.0/nrf/boards/shields/*/Kconfig.defconfig"
```
